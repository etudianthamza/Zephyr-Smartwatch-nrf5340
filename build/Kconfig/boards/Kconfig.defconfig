## build/Kconfig/boards/Kconfig.defconfig
```kconfig
# Load Zephyr board defconfig descriptions.
osource "/home/hamza/ncs/v3.2.1/zephyr/boards/nordic/nrf5340dk/Kconfig.defconfig"
```

## build/SquareLine_Project/Kconfig/arch/Kconfig
```kconfig
# Load Zephyr Arch Kconfig descriptions.
osource "/home/hamza/ncs/v3.2.1/zephyr/arch/rx/Kconfig"
osource "/home/hamza/ncs/v3.2.1/zephyr/arch/x86/Kconfig"
osource "/home/hamza/ncs/v3.2.1/zephyr/arch/xtensa/Kconfig"
osource "/home/hamza/ncs/v3.2.1/zephyr/arch/sparc/Kconfig"
osource "/home/hamza/ncs/v3.2.1/zephyr/arch/riscv/Kconfig"
osource "/home/hamza/ncs/v3.2.1/zephyr/arch/posix/Kconfig"
osource "/home/hamza/ncs/v3.2.1/zephyr/arch/mips/Kconfig"
osource "/home/hamza/ncs/v3.2.1/zephyr/arch/arm64/Kconfig"
osource "/home/hamza/ncs/v3.2.1/zephyr/arch/arm/Kconfig"
osource "/home/hamza/ncs/v3.2.1/zephyr/arch/arc/Kconfig"
```

## build/SquareLine_Project/Kconfig/boards/Kconfig
```kconfig
# Load Zephyr board Kconfig descriptions.
osource "/home/hamza/ncs/v3.2.1/zephyr/boards/nordic/nrf5340dk/Kconfig"
```

## build/SquareLine_Project/Kconfig/boards/Kconfig.nrf5340dk
```kconfig
# Load board Kconfig descriptions.
osource "/home/hamza/ncs/v3.2.1/zephyr/boards/nordic/nrf5340dk/Kconfig.nrf5340dk"
```
